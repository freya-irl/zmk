## app/boards/shields/einiso/Kconfig.defconfig
```kconfig
# Copyright (c) 2021 The ZMK Contributors
# SPDX-License-Identifier: MIT

if SHIELD_EINISO

config ZMK_KEYBOARD_NAME
    default "einiso"

endif
```

## app/boards/shields/prkl30/Kconfig.defconfig
```kconfig
# Copyright (c) 2021 The ZMK Contributors
# SPDX-License-Identifier: MIT

if SHIELD_PRKL30

config ZMK_KEYBOARD_NAME
    default "prkl30"

endif
```

## app/boards/shields/prkl30/Kconfig.shield
```kconfig
# Copyright (c) 2021 The ZMK Contributors
# SPDX-License-Identifier: MIT

config SHIELD_PRKL30
    def_bool $(shields_list_contains,prkl30)
```
